#include "satelliteComs.h"
#include <stdint.h>
#include <Arduino.h>
#include "thrusterSubsystem.h"
#include "schedule.h"


void printBool(bool input);

/******************************************************************************
 * name : satelliteComs
 *
 * inputs: satelliteComsData (void*)
 * satelliteComsData holds the pointers to the following data:
 * fuelLow: bool representing if the fuel is too low
 * batteryLow: bool representing if the battery is too low
 * solarPanelState: bool representing if the solar panel is deploued
 * batteryLevel: unsigned short representing the battery percentage
 * fuelLevel: unsigned short representing the fuel percentage
 * powerConsumption: unsigned short representing the power consumed by the system.
 * powerGeneration : unsigned short representing the power generated by the system.
 * thrusterCommand: unsigned int 32 bit thruster command
 *
 * outputs: void
 *
 * description:
 *
 * satelliteComs manages the communication from both the Earth to the Satellite and
 * the Satellite back to Earth. The primary communication from the Earth to the Satellite
 * is the thruster command. The primary communication from the Satellite to the Earth are the status
 * variables described above.
 *
 *
 * psuedocode:
 *
 * if first bit is a 0
 *  update thruster command to random command
 * else
 *  set thruster command to "invalid command" ~0
 *
 * send status info back to earth
 *
 *
 *
 *
 *  author: Nick Orlov
*****************************************************************************/

void satelliteComs(void* satelliteComsData) {
    // return early if less than 5 seconds have passed
    static unsigned long lastRunTime;
    if (globalTimeBase() - lastRunTime < MAJOR_CYCLE_DURATION_MS) {
        return;
    }
    lastRunTime = globalTimeBase();

    SatelliteComsData* data = (SatelliteComsData*) satelliteComsData;

    // 50/50 Chance for the command to be random or invalid
    // Last bit 0: random, Last bit 1: Invalid
    *data->thrusterCommand = rand();
    if (*data->thrusterCommand & 1) {
        *data->thrusterCommand = THRUSTER_CMD_NONE;
    }

    // Transferring data back to earth
    Serial.print("Fuel Low status is: ");
    printBool(*data->fuelLow);
    Serial.println();
    Serial.print("Battery Low status is: ");
    printBool(*data->batteryLow);
    Serial.println();
    Serial.print("Solar Panel state is: ");
    printBool(*data->solarPanelState);
    Serial.println();
    Serial.print("Battery Level is: ");
    Serial.println(data->batteryLevelPtr[0]);
    Serial.print("Fuel Level is: ");
    Serial.println(*data->fuelLevel);
    Serial.print("Power Consumption is: ");
    Serial.println(*data->powerConsumption);
    Serial.print("Power Generation is: ");
    Serial.println(*data->powerGeneration);
    Serial.print("Vehicle Response: A ");
    Serial.println(*data->vehicleResponse);
}

void printBool(bool input) {
    if (input) {
        Serial.print("true");
    } else {
        Serial.print("false");
    }
}